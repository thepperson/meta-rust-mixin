## conf/layer.conf
```bitbake
# We have a conf directory, append to BBPATH
BBPATH .= ":${LAYERDIR}"

# We have a recipes-* directory, add to BBFILES
BBFILES += "${LAYERDIR}/*/*/*.bb \
            ${LAYERDIR}/*/*/*.bbappend \
            ${LAYERDIR}/*/*.bb \
            ${LAYERDIR}/*/*.bbappend"

BBFILE_COLLECTIONS += "rust-mixin"
BBFILE_PATTERN_rust-mixin = "^${LAYERDIR}/"
BBFILE_PRIORITY_rust-mixin = "9"

LAYERSERIES_COMPAT_rust-mixin = "kirkstone"

LLVMVERSION = "14.0.0"
RUSTVERSION = "1.60%"
```
